## config/boards/nice_nano_v2.conf
```kconfig
# Enable underglow
CONFIG_ZMK_RGB_UNDERGLOW=y
# Use the STRIP config specific to the LEDs you're using
CONFIG_WS2812_STRIP=y

#Alex stuff
CONFIG_ZMK_RGB_UNDERGLOW_ON_START=y
CONFIG_ZMK_RGB_UNDERGLOW_SAT_START=100
CONFIG_ZMK_RGB_UNDERGLOW_BRT_START=100
CONFIG_ZMK_RGB_UNDERGLOW_HUE_START=40

CONFIG_ZMK_DISPLAY=y
CONFIG_ZMK_WIDGET_LAYER_STATUS=y
CONFIG_ZMK_WIDGET_BATTERY_STATUS=y
CONFIG_ZMK_WIDGET_OUTPUT_STATUS=y

CONFIG_ZMK_SLEEP=y
#CONFIG_ZMK_IDLE_TIMEOUT=60000
#CONFIG_ZMK_IDLE_SLEEP_TIMEOUT=72000

#CONFIG_ZMK_RGB_UNDERGLOW_AUTO_OFF_USB=y
```

## config/west.yml
```yaml
manifest:
  remotes:
    - name: achan231
      url-base: https://github.com/achan231
  projects:
    - name: zmk-alextesting
      remote: achan231
      revision: main
      import: app/west.yml
  self:
    path: config
```
